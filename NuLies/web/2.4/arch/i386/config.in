## NuLies/web/2.4/arch/i386/config.in
```kconfig
#
# For a description of the syntax of this configuration file,
# see Documentation/kbuild/config-language.txt.
#
# Traducido por David Martínez <ender@rediris.es> para el Proyecto NuLies
mainmenu_name "Configuración del núcleo Linux"

define_bool CONFIG_X86 y
define_bool CONFIG_ISA y
define_bool CONFIG_SBUS n

define_bool CONFIG_UID16 y

mainmenu_option next_comment
comment 'Opciones del nivel de madurez del código'
bool 'Preguntar por controladores/código incompleto o en desarrollo' CONFIG_EXPERIMENTAL
endmenu

mainmenu_option next_comment
comment 'Soporte de módulos cargables'
bool 'Activar soporte de módulos cargables' CONFIG_MODULES
if [ "$CONFIG_MODULES" = "y" ]; then
   bool '  Poner información de versión en todos los símbolos del módulo' CONFIG_MODVERSIONS
   bool '  Cargador de módulos en el núcleo' CONFIG_KMOD
fi
endmenu

mainmenu_option next_comment
comment 'Tipo de procesador y características'
choice 'Familia del procesador' \
	"386				CONFIG_M386 \
	 486				CONFIG_M486 \
	 586/K5/5x86/6x86/6x86MX	CONFIG_M586 \
	 Pentium-Clásico		CONFIG_M586TSC \
	 Pentium-MMX			CONFIG_M586MMX \
	 Pentium-Pro/Celeron/Pentium-II	CONFIG_M686 \
	 Pentium-III			CONFIG_MPENTIUMIII \
	 Pentium-4			CONFIG_MPENTIUM4 \
	 K6/K6-II/K6-III		CONFIG_MK6 \
	 Athlon/K7			CONFIG_MK7 \
	 Crusoe				CONFIG_MCRUSOE \
	 Winchip-C6			CONFIG_MWINCHIPC6 \
	 Winchip-2			CONFIG_MWINCHIP2 \
	 Winchip-2A/Winchip-3		CONFIG_MWINCHIP3D" Pentium-Pro
#
# Define implied options from the CPU selection here
#

if [ "$CONFIG_M386" = "y" ]; then
   define_bool CONFIG_X86_CMPXCHG n
   define_int  CONFIG_X86_L1_CACHE_SHIFT 4
else
   define_bool CONFIG_X86_WP_WORKS_OK y
   define_bool CONFIG_X86_INVLPG y
   define_bool CONFIG_X86_CMPXCHG y
   define_bool CONFIG_X86_BSWAP y
   define_bool CONFIG_X86_POPAD_OK y
fi
if [ "$CONFIG_M486" = "y" ]; then
   define_int  CONFIG_X86_L1_CACHE_SHIFT 4
   define_bool CONFIG_X86_USE_STRING_486 y
   define_bool CONFIG_X86_ALIGNMENT_16 y
fi
if [ "$CONFIG_M586" = "y" ]; then
   define_int  CONFIG_X86_L1_CACHE_SHIFT 5
   define_bool CONFIG_X86_USE_STRING_486 y
   define_bool CONFIG_X86_ALIGNMENT_16 y
fi
if [ "$CONFIG_M586TSC" = "y" ]; then
   define_int  CONFIG_X86_L1_CACHE_SHIFT 5
   define_bool CONFIG_X86_USE_STRING_486 y
   define_bool CONFIG_X86_ALIGNMENT_16 y
   define_bool CONFIG_X86_TSC y
fi
if [ "$CONFIG_M586MMX" = "y" ]; then
   define_int  CONFIG_X86_L1_CACHE_SHIFT 5
   define_bool CONFIG_X86_USE_STRING_486 y
   define_bool CONFIG_X86_ALIGNMENT_16 y
   define_bool CONFIG_X86_TSC y
   define_bool CONFIG_X86_GOOD_APIC y
fi
if [ "$CONFIG_M686" = "y" ]; then
   define_int  CONFIG_X86_L1_CACHE_SHIFT 5
   define_bool CONFIG_X86_TSC y
   define_bool CONFIG_X86_GOOD_APIC y
   define_bool CONFIG_X86_PGE y
   define_bool CONFIG_X86_USE_PPRO_CHECKSUM y
fi
if [ "$CONFIG_MPENTIUMIII" = "y" ]; then
   define_int  CONFIG_X86_L1_CACHE_SHIFT 5
   define_bool CONFIG_X86_TSC y
   define_bool CONFIG_X86_GOOD_APIC y
   define_bool CONFIG_X86_PGE y
   define_bool CONFIG_X86_USE_PPRO_CHECKSUM y
fi
if [ "$CONFIG_MPENTIUM4" = "y" ]; then
   define_int  CONFIG_X86_L1_CACHE_SHIFT 7
   define_bool CONFIG_X86_TSC y
   define_bool CONFIG_X86_GOOD_APIC y
   define_bool CONFIG_X86_PGE y
   define_bool CONFIG_X86_USE_PPRO_CHECKSUM y
fi
if [ "$CONFIG_MK6" = "y" ]; then
   define_int  CONFIG_X86_L1_CACHE_SHIFT 5
   define_bool CONFIG_X86_ALIGNMENT_16 y
   define_bool CONFIG_X86_TSC y
   define_bool CONFIG_X86_USE_PPRO_CHECKSUM y
fi
if [ "$CONFIG_MK7" = "y" ]; then
   define_int  CONFIG_X86_L1_CACHE_SHIFT 6
   define_bool CONFIG_X86_TSC y
   define_bool CONFIG_X86_GOOD_APIC y
   define_bool CONFIG_X86_USE_3DNOW y
   define_bool CONFIG_X86_PGE y
   define_bool CONFIG_X86_USE_PPRO_CHECKSUM y
fi
if [ "$CONFIG_MCRUSOE" = "y" ]; then
   define_int  CONFIG_X86_L1_CACHE_SHIFT 5
   define_bool CONFIG_X86_TSC y
fi
if [ "$CONFIG_MWINCHIPC6" = "y" ]; then
   define_int  CONFIG_X86_L1_CACHE_SHIFT 5
   define_bool CONFIG_X86_ALIGNMENT_16 y
   define_bool CONFIG_X86_USE_PPRO_CHECKSUM y
fi
if [ "$CONFIG_MWINCHIP2" = "y" ]; then
   define_int  CONFIG_X86_L1_CACHE_SHIFT 5
   define_bool CONFIG_X86_ALIGNMENT_16 y
   define_bool CONFIG_X86_TSC y
   define_bool CONFIG_X86_USE_PPRO_CHECKSUM y
fi
if [ "$CONFIG_MWINCHIP3D" = "y" ]; then
   define_int  CONFIG_X86_L1_CACHE_SHIFT 5
   define_bool CONFIG_X86_ALIGNMENT_16 y
   define_bool CONFIG_X86_TSC y
   define_bool CONFIG_X86_USE_PPRO_CHECKSUM y
fi
tristate 'Soporte para portátiles Toshiba' CONFIG_TOSHIBA

tristate '/dev/cpu/microcode - Soporte para microcódigo de CPUs Intel IA32' CONFIG_MICROCODE
tristate '/dev/cpu/*/msr - Soporte para registros específicos del modelo' CONFIG_X86_MSR
tristate '/dev/cpu/*/cpuid - Soporte para información de CPU' CONFIG_X86_CPUID

choice 'Soporte para Memoria Alta (High Memory)' \
	"off    CONFIG_NOHIGHMEM \
	 4GB    CONFIG_HIGHMEM4G \
	 64GB   CONFIG_HIGHMEM64G" off
if [ "$CONFIG_HIGHMEM4G" = "y" ]; then
   define_bool CONFIG_HIGHMEM y
fi
if [ "$CONFIG_HIGHMEM64G" = "y" ]; then
   define_bool CONFIG_HIGHMEM y
   define_bool CONFIG_X86_PAE y
fi

bool 'Emulación matemática' CONFIG_MATH_EMULATION
bool 'Soporte para MTRR (Memory Type Range Register)' CONFIG_MTRR
bool 'Soporte para multiproceso simétrico' CONFIG_SMP
if [ "$CONFIG_SMP" != "y" ]; then
   bool 'Soporte APIC e IO-APIC en uniprocesadores' CONFIG_X86_UP_IOAPIC
   if [ "$CONFIG_X86_UP_IOAPIC" = "y" ]; then
      define_bool CONFIG_X86_IO_APIC y
      define_bool CONFIG_X86_LOCAL_APIC y
   fi
fi

if [ "$CONFIG_SMP" = "y" -a "$CONFIG_X86_CMPXCHG" = "y" ]; then
   define_bool CONFIG_HAVE_DEC_LOCK y
fi
endmenu

mainmenu_option next_comment
comment 'Configuración general'

bool 'Soporte de red' CONFIG_NET
bool 'Soporte para estación de trabajo SGI Visual' CONFIG_VISWS
if [ "$CONFIG_VISWS" = "y" ]; then
   define_bool CONFIG_X86_VISWS_APIC y
   define_bool CONFIG_X86_LOCAL_APIC y
   define_bool CONFIG_PCI y
else
   if [ "$CONFIG_SMP" = "y" ]; then
      define_bool CONFIG_X86_IO_APIC y
      define_bool CONFIG_X86_LOCAL_APIC y
   fi
   bool 'Soporte PCI' CONFIG_PCI
   if [ "$CONFIG_PCI" = "y" ]; then
      choice '  Modo de acceso PCI' \
	"BIOS		CONFIG_PCI_GOBIOS	\
	 Direct		CONFIG_PCI_GODIRECT	\
	 Any		CONFIG_PCI_GOANY"	Any
      if [ "$CONFIG_PCI_GOBIOS" = "y" -o "$CONFIG_PCI_GOANY" = "y" ]; then
         define_bool CONFIG_PCI_BIOS y
      fi
      if [ "$CONFIG_PCI_GODIRECT" = "y" -o "$CONFIG_PCI_GOANY" = "y" ]; then
         define_bool CONFIG_PCI_DIRECT y
      fi
   fi
fi

source drivers/pci/Config.in

bool 'Soporte EISA' CONFIG_EISA

if [ "$CONFIG_VISWS" != "y" ]; then
   bool 'Soporte MCA' CONFIG_MCA
else
   define_bool CONFIG_MCA n
fi

bool 'Soporte para dispositivos intercambiables en caliente (hot-pluggable)' CONFIG_HOTPLUG

if [ "$CONFIG_HOTPLUG" = "y" ] ; then
   source drivers/pcmcia/Config.in
else
   define_bool CONFIG_PCMCIA n
fi

bool 'IPCs de System V' CONFIG_SYSVIPC
bool 'Seguimiento de procesos BSD (Process Accounting)' CONFIG_BSD_PROCESS_ACCT
bool 'Soporte de sysctl' CONFIG_SYSCTL
if [ "$CONFIG_PROC_FS" = "y" ]; then
   choice 'Formato del corazón (/proc/kcore) del núcleo' \
	"ELF		CONFIG_KCORE_ELF	\
	 A.OUT		CONFIG_KCORE_AOUT" ELF
fi
tristate 'Soporte en el núcleo para binarios a.out' CONFIG_BINFMT_AOUT
tristate 'Soporte en el núcleo para binarios ELF' CONFIG_BINFMT_ELF
tristate 'Soporte en el núcleo para binarios MISC' CONFIG_BINFMT_MISC

bool 'Soporte para Gestión de Energía (Power Management)' CONFIG_PM

if [ "$CONFIG_EXPERIMENTAL" = "y" ]; then
   dep_bool '  Soporte ACPI' CONFIG_ACPI $CONFIG_PM
fi

dep_tristate '  Soporte de BIOS con Gestión Avanzada de Energía (APM)' CONFIG_APM $CONFIG_PM
if [ "$CONFIG_APM" != "n" ]; then
   bool '    Ignorar USER SUSPEND' CONFIG_APM_IGNORE_USER_SUSPEND
   bool '    Activar Gestión de Energía en tiempo de inicio' CONFIG_APM_DO_ENABLE
   bool '    Hacer llamadas de CPU Idle cuando se está desocupado' CONFIG_APM_CPU_IDLE
   bool '    Activar el apagado de la consola usando APM' CONFIG_APM_DISPLAY_BLANK
   bool '    El RTC almacena la hora en GMT' CONFIG_APM_RTC_IS_GMT
   bool '    Permitir interrupciones durante llamadas a la BIOS APM' CONFIG_APM_ALLOW_INTS
   bool '    Usar llamadas en modo real a la BIOS APM para apagar el equipo' CONFIG_APM_REAL_MODE_POWER_OFF
fi

endmenu

source drivers/mtd/Config.in

source drivers/parport/Config.in

source drivers/pnp/Config.in

source drivers/block/Config.in

source drivers/md/Config.in

if [ "$CONFIG_NET" = "y" ]; then
   source net/Config.in
fi

source drivers/telephony/Config.in

mainmenu_option next_comment
comment 'Soporte ATA/IDE/MFM/RLL'

tristate 'Soporte ATA/IDE/MFM/RLL' CONFIG_IDE

if [ "$CONFIG_IDE" != "n" ]; then
   source drivers/ide/Config.in
else
   define_bool CONFIG_BLK_DEV_IDE_MODES n
   define_bool CONFIG_BLK_DEV_HD n
fi
endmenu

mainmenu_option next_comment
comment 'Soporte SCSI'

tristate 'Soporte SCSI' CONFIG_SCSI

if [ "$CONFIG_SCSI" != "n" ]; then
   source drivers/scsi/Config.in
fi
endmenu

source drivers/ieee1394/Config.in

source drivers/i2o/Config.in

if [ "$CONFIG_NET" = "y" ]; then
   mainmenu_option next_comment
   comment 'Soporte de dispositivos de red'

   bool 'Soporte de dispositivos de red' CONFIG_NETDEVICES
   if [ "$CONFIG_NETDEVICES" = "y" ]; then
      source drivers/net/Config.in
      if [ "$CONFIG_ATM" = "y" ]; then
         source drivers/atm/Config.in
      fi
   fi
   endmenu
fi

source net/ax25/Config.in

source net/irda/Config.in

mainmenu_option next_comment
comment 'Subsistema RDSI (ISDN)'
if [ "$CONFIG_NET" != "n" ]; then
   tristate 'Soporte RDSI (ISDN)' CONFIG_ISDN
   if [ "$CONFIG_ISDN" != "n" ]; then
      source drivers/isdn/Config.in
   fi
fi
endmenu

mainmenu_option next_comment
comment 'Controladores de CD-ROMs antiguos (ni SCSI, ni IDE)'

bool 'Soporte para unidades CDROM no-SCSI/IDE/ATAPI' CONFIG_CD_NO_IDESCSI
if [ "$CONFIG_CD_NO_IDESCSI" != "n" ]; then
   source drivers/cdrom/Config.in
fi
endmenu

#
# input before char - char/joystick depends on it. As does USB.
#
source drivers/input/Config.in
source drivers/char/Config.in

#source drivers/misc/Config.in

source drivers/media/Config.in

source fs/Config.in

if [ "$CONFIG_VT" = "y" ]; then
   mainmenu_option next_comment
   comment 'Controladores para consola'
   bool 'Consola VGA de texto' CONFIG_VGA_CONSOLE
   bool 'Soporte para selección del modo de vídeo' CONFIG_VIDEO_SELECT
   if [ "$CONFIG_EXPERIMENTAL" = "y" ]; then
      tristate 'Soporte para consola MDA de texto (dual-headed) (EXPERIMENTAL)' CONFIG_MDA_CONSOLE
      source drivers/video/Config.in
   fi
   endmenu
fi

mainmenu_option next_comment
comment 'Sound'

tristate 'Sound card support' CONFIG_SOUND
if [ "$CONFIG_SOUND" != "n" ]; then
   source drivers/sound/Config.in
fi
endmenu

source drivers/usb/Config.in

mainmenu_option next_comment
comment 'Hacking del núcleo'

#bool 'Depurar kmalloc/kfree' CONFIG_DEBUG_MALLOC
bool 'Tecla mágica SysRq' CONFIG_MAGIC_SYSRQ
endmenu
```
